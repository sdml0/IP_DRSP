#include "unix_time.h"
#include "tcpip.h"
#include "diskio.h"

#define CH_NUM 8
#define DELTA sizeof(webif_page)/3
#define DIR ((RecordIndex*)ptr)
#define PASS1 0x402A3452					// "R4*@g2k!"
#define PASS2 0x216B3267
#define _FRAME ((eth_frame_t*)net_buf)

static const uint16_t fw_ver = 1;

const uint8_t def_names[141] = {
    0xD0, 0x9A, 0xD0, 0xB0, 0xD0, 0xBD, 0xD0, 0xB0, 0xD0, 0xBB, 0x2D, 0x31, 0x24, 0xD0, 0x9A, 0xD0,
    0xB0, 0xD0, 0xBD, 0xD0, 0xB0, 0xD0, 0xBB, 0x2D, 0x32, 0x24, 0xD0, 0x9A, 0xD0, 0xB0, 0xD0, 0xBD,
    0xD0, 0xB0, 0xD0, 0xBB, 0x2D, 0x33, 0x24, 0xD0, 0x9A, 0xD0, 0xB0, 0xD0, 0xBD, 0xD0, 0xB0, 0xD0,
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    0xB2, 0xD0, 0xB5, 0xD1, 0x81, 0xD1, 0x82, 0xD0, 0xBD, 0xD0, 0xB0, 0xD1, 0x8F 
};

typedef struct {
	uint32_t	time;
	uint32_t	sector;
} RecordIndex;
extern uint8_t ch_names[];
extern uint16_t crit_thr[];
extern RecordIndex indBuf[64 + CH_NUM - 1];
extern volatile uint8_t dirInd, active;
extern volatile uint16_t fullWritten;
extern volatile uint32_t curSector, indSector, indexAreaSize, cardSize1, Status;
extern uint32_t ip_addr;
extern uint8_t mac_addr[6];
extern uint8_t net_buf[];
extern uint32_t ip_addr;

const uint8_t webif_404_reply[275] =
	"HTTP/1.0 404 Not Found\r\n"
	"Content-Type: text/html\r\n"
	"Access-Control-Allow-Origin: *\r\n"
	"Server: stm32f103\r\n"
	"Content-Encoding: identity\r\n"
	"Content-Length: 124\r\n"
	"\r\n"
	"<!DOCTYPE html>\r\n"
	"<html>\r\n"
   "<head></head>\r\n"
   "<body>\r\n"
   "<pre>Page not found\r\n\r\n"
	"<a href='/'>Home page</a></pre>\r\n"
   "</body>\r\n"
	"</html>\r\n\r\n";

const uint8_t raw_200_data[74] = "HTTP/1.0 200 OK\r\nAccess-Control-Allow-Origin: *\r\nContent-Length: 00000\r\n\r\n";
	
static const uint8_t webif_200_header[] =
	"HTTP/1.0 200 OK\r\n"
	"Content-Type: text/html\r\n"
	"Server: stm32f103\r\n"
	"Content-Encoding: gzip\r\n"
	"Content-Length: 0000\r\n\r\n";

static const uint8_t webif_page[2667] = {
    0x1F, 0x8B, 0x08, 0x00, 0xAE, 0x35, 0x41, 0x5A, 0x00, 0x00, 0xDD, 0x5A, 0xFD, 0x6E, 0xE3, 0x44,
    0x10, 0xFF, 0x1B, 0x24, 0xDE, 0x61, 0xB1, 0x80, 0xD8, 0xD7, 0xC4, 0xB1, 0x9D, 0xA4, 0x4D, 0x68,
    0x1A, 0x04, 0xE5, 0x0E, 0x90, 0xF8, 0x12, 0x2D, 0x12, 0xA8, 0x8A, 0x22, 0xC7, 0xDE, 0x34, 0xAB,
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    0x50, 0xF2, 0x17, 0x11, 0xC7, 0x98, 0x63, 0x60, 0x22, 0x00, 0x00 
};



static const uint8_t webif_setup[1919] = {
    0x1F, 0x8B, 0x08, 0x00, 0x76, 0x05, 0x4A, 0x5A, 0x00, 0x00, 0xD5, 0x59, 0x79, 0x8B, 0xD3, 0x40,
    0x14, 0xFF, 0x5F, 0xF0, 0x3B, 0x8C, 0x41, 0x6C, 0x63, 0xDD, 0xB6, 0x49, 0x5B, 0xAD, 0xDD, 0x76,
    0xBD, 0x2F, 0x3C, 0xF1, 0x40, 0x45, 0x4B, 0x89, 0xCD, 0x74, 0x3B, 0x9A, 0x26, 0x31, 0x99, 0xB8,
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    0x73, 0x55, 0xF8, 0x2F, 0x6A, 0x3F, 0x01, 0xEA, 0x74, 0x0E, 0x24, 0x61, 0x1B, 0x00, 0x00 
};


void http_reply_OK()
{
	uint8_t* ptr = TCP_PKT(net_buf)->data;
	
	mem_cpy(ptr, raw_200_data, sizeof(raw_200_data) );
	tcp_xmit(_FRAME, sizeof(raw_200_data) );
}

void http_reply_404()
{
	uint8_t* ptr = TCP_PKT(net_buf)->data;
	
	mem_cpy(ptr, webif_404_reply, sizeof(webif_404_reply) - 1);
	tcp_xmit(_FRAME, sizeof(webif_404_reply) - 1);
}

uint32_t parse_POST(uint8_t **req)
{
	uint8_t* ptr = *req;
	uint32_t len = 0;

	while ((*(uint32_t*)ptr != 0x746E6F43) || (*(uint32_t*)(ptr + 4) != 0x2D746E65) ||
	(*(uint32_t*)(ptr + 8) != 0x676E654C) || (*(uint32_t*)(ptr + 12) != 0x203A6874)) ptr++; 		//	"Content-Length: "
			
		ptr += 16;
		while ((*ptr <= 0x39) && (*ptr >= 0x30)) {
			len = 10*len + *ptr - 0x30;
			ptr++;
		}
	while (*(uint32_t*)ptr != 0x0A0D0A0D) ptr++;
		
	*req = ptr + 4;
	return len;
	
	
}

uint32_t let2int (uint32_t* str)
{	
	uint32_t t0, t1;
	
	t0 = str[0] - 0x61616161;			// little endian sent - rev view
	t0 = (t0>>4) | t0;
	t0 = ((t0>>8)&0xFF00) | (t0&0xFF);
	t1 = str[1] - 0x61616161;
	t1 = (t1>>4) | t1;
	t1 = ((t1<<8)&0xFF000000) | ((t1<<16)&0xFF0000);
		
	return t1 | t0;
}

uint32_t hex2int(uint8_t* str)
{
	uint32_t res = 0;
	uint8_t c;
	
	while (1) {
		c = *str;
		if ((c <= 0x39) && (c >= 0x30)) c -= 0x30;
		else if ((c <= 0x41) && (c >= 0x46)) c -= 0x41 - 0xA;
		else if ((c <= 0x61) && (c >= 0x66)) c -= 0x61 - 0xA;
		else break;
		res = (res<<4) | c;
		str++;		
	}

	return res;
}

uint32_t dec2int(uint8_t* str)
{
	uint32_t res = 0;
	uint8_t c;
	
	while (1) {
		c = *str;
		if ((c <= 0x39) && (c >= 0x30)) c -= 0x30;
		else break;
		res = 10*res + c;
		str++;		
	}

	return res;
}

uint16_t byte2hex(uint8_t n)
{
	uint16_t res;
	
	if ((n & 0xF) < 10) res = ('0' + (n & 0xF));
	else res = ('A' + (n & 0xF) - 10);
	n >>= 4;
	res <<= 8;
	if (n < 10) res |= '0' + n;
	else res |= 'A' + n - 10;

	return res;
}

void IntToStr(uint8_t* endOfBuf, uint32_t n)
{
	uint32_t m;
		
	while(n) {
		endOfBuf--;
		m = n;
		n /= 10;
		*endOfBuf = m - 10*n + '0';
	}
}

void tcp_write(int16_t len)
{
	uint8_t* req = tcp_get_data(TCP_PKT(net_buf));
	uint8_t* ptr = TCP_PKT(net_buf)->data;
	int32_t t, sec, dep;
	uint16_t s;
	
	if(*(uint32_t*)req == 0x20544547) {	// GET
		
		if ((*(uint32_t*)(req + 4) == 0x65723F2F) && (*(uint32_t*)(req + 8) == 0x5F5F5F63)) {				// "/?rec___"
			t = let2int((uint32_t*)(req + 12));
			if ((t < indexAreaSize) || (t > cardSize1)) {http_reply_404(); return;}
			mem_cpy(ptr, raw_200_data, sizeof(raw_200_data) );
			ptr += sizeof(raw_200_data) ;
			req = ptr;
			s = 0;
			for (s = 0; (s < 8) && t; s++) {
				if(read_sector(ptr, t)) break;
				ptr += 508;
				t = *(uint32_t*)ptr;
			}
			t = 508*s + 4;
			IntToStr(req - 4, t);
			t += sizeof(raw_200_data) ;
			ptr = net_buf;
			while (t > 1056) {
				tcp_xmit((eth_frame_t*)ptr, 1056);
				mem_cpy(ptr + 1056, ptr, FULL_HEAD_SIZE);
				ptr += 1056;
				t -= 1056;
			}
			tcp_xmit((eth_frame_t*)ptr, t);
		}
		else if ((*(uint32_t*)(req + 4) == 0x70643F2F) && (*(uint32_t*)(req + 8) == 0x5F766572)) {			// "/?dprev_"
			sec = let2int((uint32_t*)(req + 12));		// sector
			dep = let2int((uint32_t*)(req + 20));		// depth
			mem_cpy(ptr, raw_200_data, sizeof(raw_200_data) );
			ptr += sizeof(raw_200_data) ;
			if ((sec > 1) || fullWritten) {
				sec = sec > 1 ? sec - 1 : indexAreaSize;
				read_sector(ptr, sec);
				s = 64;
				while(s) {
					s--;
					t = (DIR[s].sector & 0x1FFFFFFF) - curSector;
					if (t < 0) t += cardSize1 - indexAreaSize;
					if ((t < 6000) || (t > dep)) {
						s++;
						dep = 0;
						if (s < 64) mem_cpy(ptr, ptr + 8*s, 512 - 8*s);
						break;
					}
					else dep = t;
				}
			}
			else s = 64;
			s = 512 - 8*s;
			IntToStr(ptr - 4, 8 + s);
			ptr += s;
			*(uint32_t*)ptr = sec;
			*(uint32_t*)(ptr + 4) = dep;
			tcp_xmit(_FRAME,  s + 8 + sizeof(raw_200_data) );
		}
		else if ((*(uint32_t*)(req + 4) == 0x6E643F2F) && (*(uint32_t*)(req + 8) == 0x5F747865)) {			// "/?dnext_"
			sec = let2int((uint32_t*)(req + 12));
			if (!sec) sec = indSector;
			else if (sec != indSector) sec = sec < indexAreaSize ? sec + 1 : 1;
			mem_cpy(ptr, raw_200_data, sizeof(raw_200_data) );
			ptr += sizeof(raw_200_data) ;
			if (sec == indSector) {
				s = 8*dirInd;
				if (s) mem_cpy(ptr, (uint8_t*)indBuf, s);
				t = cardSize1 - indexAreaSize;
			}
			else {
				s = 512;
				read_sector(ptr, sec);
				t = (DIR[0].sector & 0x1FFFFFFF) - curSector;
				if (t < 0) t += cardSize1 - indexAreaSize;
			}
			IntToStr(ptr - 4, s + 8);
			ptr += s;
			*(uint32_t*)ptr = sec;
			ptr += 4;
			*(uint32_t*)ptr = t;
			tcp_xmit(_FRAME,  s + 8 + sizeof(raw_200_data) );
		}
		else if ((*(uint32_t*)(req + 4) == 0x72703F2F) && (*(uint32_t*)(req + 8) == 0x5F5F706F)) {			// "/?prop__"
			mem_cpy(ptr, raw_200_data, sizeof(raw_200_data));
			ptr += sizeof(raw_200_data) ;
			IntToStr(ptr - 4, 64 + 12 + 16 + 18 + ch_names[0] + 15);
			//------------crit_thr
			for (s = 0; s < 8; s++) {
				*(uint32_t*)ptr = 0x30303030;
				*(uint32_t*)(ptr + 4) = 0x24303030;
				ptr += 8;
				IntToStr(ptr - 1, 100 - crit_thr[s]/5);
			}
			//------------Time
			*(uint32_t*)ptr = 0x30303030;
			*(uint32_t*)(ptr + 4) = 0x30303030;
			*(uint32_t*)(ptr + 8) = 0x24303030;
			ptr += 12;
			IntToStr(ptr - 1, RTC->CNTH<<16 | RTC->CNTL);
			//------------IP
			*(uint32_t*)ptr = 0x2E303030;
			ptr += 4;
			IntToStr(ptr - 1, ip_addr & 0xFF);
			*(uint32_t*)ptr = 0x2E303030;
			ptr += 4;
			IntToStr(ptr - 1, (ip_addr>>8) & 0xFF);
			*(uint32_t*)ptr = 0x2E303030;
			ptr += 4;
			IntToStr(ptr - 1, (ip_addr>>16) & 0xFF);
			*(uint32_t*)ptr = 0x24303030;
			ptr += 4;
			IntToStr(ptr - 1, (ip_addr>>24) & 0xFF);
			//------------MAC
			*(uint16_t*)ptr 		= byte2hex(mac_addr[0]);
			*(ptr + 2) = ':';
			*(uint16_t*)(ptr + 3) = byte2hex(mac_addr[1]);
			*(ptr + 5) = ':';
			*(uint16_t*)(ptr + 6) = byte2hex(mac_addr[2]);
			*(ptr + 8) = ':';
			*(uint16_t*)(ptr + 9) = byte2hex(mac_addr[3]);
			*(ptr + 11) = ':';
			*(uint16_t*)(ptr + 12) = byte2hex(mac_addr[4]);
			*(ptr + 14) = ':';
			*(uint16_t*)(ptr + 15) = byte2hex(mac_addr[5]);
			*(ptr + 17) = '$';
			ptr += 18;
			//------------Names
			mem_cpy(ptr, ch_names + 1, ch_names[0]);
			ptr += ch_names[0];
			*(ptr++) = '$';
			//------------Status
			*(uint16_t*)ptr 			= byte2hex(Status>>24);
			*(uint16_t*)(ptr + 2) 	= byte2hex((Status>>16) & 0xFF);
			*(uint16_t*)(ptr + 4) 	= byte2hex((Status>>8) & 0xFF);
			*(uint16_t*)(ptr + 6) 	= byte2hex(Status & 0xFF);
			*(ptr + 8) = '$';
			ptr += 9;
			//------------fw_ver
			*(uint16_t*)ptr = byte2hex(fw_ver >> 8);
			*(ptr + 2) = '.';
			*(uint16_t*)(ptr + 3) = byte2hex(fw_ver & 0xFF);
			
			tcp_xmit(_FRAME, sizeof(raw_200_data) + 64 + 12 + 16 + 18 + ch_names[0] + 15);
			
		}
		else if(*(uint16_t*)(req + 4) == 0x202F) {																			//Home page
			mem_cpy(ptr, webif_200_header, sizeof(webif_200_header) - 1);
			IntToStr(ptr + sizeof(webif_200_header) - 5, sizeof(webif_page));
			mem_cpy(ptr + sizeof(webif_200_header) - 1, webif_page, DELTA);
			tcp_xmit(_FRAME, sizeof(webif_200_header)  - 1 + DELTA);
			mem_cpy(ptr, webif_page + DELTA, DELTA);
			tcp_xmit(_FRAME, DELTA);
			mem_cpy(ptr, webif_page + 2*DELTA, sizeof(webif_page) - 2*DELTA);
			tcp_xmit(_FRAME, sizeof(webif_page) - 2*DELTA);
		}
		/*else if ((*(uint32_t*)(req + 4) == 0x64723F2F) && (*(uint32_t*)(req + 8) == 0x5F5F6473)) {			// "/?rdsd__"
			t = hex2int(req + 12);
			mem_cpy(ptr, raw_200_data, sizeof(raw_200_data) );
			ptr += sizeof(raw_200_data) ;
			if (t == 0) {
				s = 8*dirInd;
				if(s) mem_cpy(ptr, (uint8_t*)indBuf, s);
			}
			else {
				s = 512;
				read_sector(ptr, t);
			}
			IntToStr(ptr - 4, s);
			tcp_xmit(_FRAME, s + sizeof(raw_200_data) );
		}*/
		else if ((*(uint32_t*)(req + 4) == 0x65733F2F) && (*(uint32_t*)(req + 8) == 0x5F707574)) {			// "/?setup_"
			mem_cpy(ptr, webif_200_header, sizeof(webif_200_header) - 1);
			IntToStr(ptr + sizeof(webif_200_header) - 5, sizeof(webif_setup));
			mem_cpy(ptr + sizeof(webif_200_header) - 1, webif_setup, sizeof(webif_setup) - 1000);
			tcp_xmit(_FRAME, sizeof(webif_200_header)  - 1 + sizeof(webif_setup) - 1000);
			mem_cpy(ptr, webif_setup + sizeof(webif_setup) - 1000, 1000);
			tcp_xmit(_FRAME, 1000);
		}
		else if ((*(uint32_t*)(req + 4) == 0x65723F2F) && (*(uint32_t*)(req + 8) == 0x746F6F62) && (*(uint32_t*)(req + 12) == PASS1)
					 && (*(uint32_t*)(req + 16) == PASS2) &&	(crit_thr[0] > 0)) {										// "/?reboot"
			for (s = 0; s < 8; s++) crit_thr[s] = -crit_thr[s];
			http_reply_OK();
		}
		else if ((*(uint32_t*)(req + 4) == 0x68743F2F) && (*(uint32_t*)(req + 8) == 0x68736572) &&
					(*(uint32_t*)(req + 12) == PASS1) && (*(uint32_t*)(req + 16) == PASS2)) {						// "/?thresh"
			t = let2int((uint32_t*)(req + 20));
			for(s = 0; s < 4; s++) {
				crit_thr[s] = 502 - 5*(t & 0xFF);
				t >>= 8;
			}
			t = let2int((uint32_t*)(req + 28));
			for(; s < 8; s++) {
				crit_thr[s] = 502 - 5*(t & 0xFF);
				t >>= 8;
			}
			http_reply_OK();
		}
		else if ((*(uint32_t*)(req + 4) == 0x69743F2F) && (*(uint32_t*)(req + 8) == 0x5F5F656D) &&
					(*(uint32_t*)(req + 12) == PASS1) && (*(uint32_t*)(req + 16) == PASS2)) {						// "/?time__"
			t = let2int((uint32_t*)(req + 20));
			RTC_Set(t);
			http_reply_OK();
		}
		else if ((*(uint32_t*)(req + 4) == 0x65733F2F) && (*(uint32_t*)(req + 8) == 0x5F706974) &&
					(*(uint32_t*)(req + 12) == PASS1) && (*(uint32_t*)(req + 16) == PASS2)) {						// "/?setip_"
			t = let2int((uint32_t*)(req + 20));
			ip_addr = t;
			BB_REG(&PWR->CR)[8] = 1;
			BKP->DR2 = ip_addr & 0xFFFF;
			BKP->DR3 = (ip_addr>>16) & 0xFFFF;
			BB_REG(&PWR->CR)[8] = 0;
			http_reply_OK();			
		}
		else if ((*(uint32_t*)(req + 4) == 0x65733F2F) && (*(uint32_t*)(req + 8) == 0x63616D74) &&
					(*(uint32_t*)(req + 12) == PASS1) && (*(uint32_t*)(req + 16) == PASS2)) {						// "/?setmac"
			t = let2int((uint32_t*)(req + 20));
			
			for(s = 0; s < 4; s++) {
				mac_addr[s] = t & 0xFF;
				t >>= 8;
			}
			req +=28;
			t = *(uint32_t*)req - 0x61616161;
			t = (t>>4) | t;
			mac_addr[4] = t & 0xFF;
			mac_addr[5] = (t>>16) & 0xFF;
			enc28j60_set_mac(mac_addr);
			BB_REG(&PWR->CR)[8] = 1;
			BKP->DR4 = *(uint16_t*)mac_addr;
			BKP->DR5 = *(uint16_t*)(mac_addr + 2);
			BKP->DR6 = *(uint16_t*)(mac_addr + 4);
			BB_REG(&PWR->CR)[8] = 0;
			http_reply_OK();
		}
		else http_reply_404();
																							// end of GET
	}
	else if(*(uint32_t*)req == 0x54534F50)	{	// POST

		if ((*(uint32_t*)(req + 4) == 0x6E3F2F20) && (*(uint32_t*)(req + 8) == 0x73656D61) &&
					(*(uint32_t*)(req + 12) == PASS1) && (*(uint32_t*)(req + 16) == PASS2)) {						// " /?names"
			ptr = req + 20;
			t = parse_POST(&ptr);
			len -= ptr - req;
			if ((len <=0) | (len > 255)) {http_reply_404(); return;}
			mem_cpy(ch_names + 1, ptr, len);
			ch_names[0] = len;
			http_reply_OK();
		}
		else http_reply_404();
	}
	else http_reply_404();
}


